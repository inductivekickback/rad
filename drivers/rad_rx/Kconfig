## drivers/rad_rx/Kconfig
```kconfig
# Rad receiver driver
#
# Copyright (c) 2021 Daniel Veilleux
#
# SPDX-License-Identifier: LicenseRef-BSD-5-Clause-Nordic
#

menuconfig RAD_RX
	bool "Rad laser tag receiver driver"
	select GPIO
	help
	  Enable Rad laser tag receiver driver

if RAD_RX

config RAD_RX_ACCEPT_DYNASTY
	bool "Accept messages from Dynasty Toys blasters (probably also Lightbattle, Kidzlane, JOYMOR, etc.)"
	select RAD_MSG_TYPE_DYNASTY
	default y
	help
		Accept messages from Dynasty Toys blasters, a generic and now defunct brand

config RAD_RX_ACCEPT_LASER_X
	bool "Accept messages from Laser X blasters"
	select RAD_MSG_TYPE_LASER_X
	default y
	help
		Accept messages from Laser X blasters

config RAD_RX_ACCEPT_RAD
	bool "Accept messages from Rad blasters"
	select RAD_MSG_TYPE_RAD
	default y
	help
		Accept messages from Rad blasters

config RAD_RX_INIT_PRIORITY
	int "Rad laser tag receiver init priority"
	default 90
	help
	  Rad laser tag receiver init priority

module = RAD_RX
module-str = RAD_RX
source "${ZEPHYR_BASE}/subsys/logging/Kconfig.template.log_config"

endif #RAD_RX
```

## drivers/rad_tx/Kconfig
```kconfig
# Rad transmitter driver
#
# Copyright (c) 2021 Daniel Veilleux
#
# SPDX-License-Identifier: LicenseRef-BSD-5-Clause-Nordic
#

menuconfig RAD_TX
	bool "Rad laser tag transmitter driver"
	select NRFX_PWM
	select DYNAMIC_INTERRUPTS
	help
	  Enable Rad laser tag transmitter driver

if RAD_TX

config RAD_TX_DYNASTY
	bool "Enable sending messages to Dynasty Toys blasters (probably also Lightbattle, Kidzlane, JOYMOR, etc.)"
	select RAD_MSG_TYPE_DYNASTY
	default y
	help
		Enable sending messages to Dynasty Toys blasters, a generic and now defunct brand

config RAD_TX_LASER_X
	bool "Enable sending messages to Laser X blasters"
	select RAD_MSG_TYPE_LASER_X
	default y
	help
		Enable sending messages to Laser X blasters

config RAD_TX_RAD
	bool "Enable sending messages to Rad blasters"
	select RAD_MSG_TYPE_RAD
	default y
	help
		Enable sending messages to Rad blasters

config RAD_TX_INIT_PRIORITY
	int "Rad laser tag transmitter init priority"
	default 90
	help
	  Rad laser tag transmitter init priority

config RAD_TX_ALLOW_PWM0
	bool "Allow PWM0"
	default y
    select NRFX_PWM0
	help
		Allow the driver to use PWM peripheral instance 0

config RAD_TX_ALLOW_PWM1
	bool "Allow PWM1"
	default y
    select NRFX_PWM1
	help
		Allow the driver to use PWM peripheral instance 1

config RAD_TX_ALLOW_PWM2
	bool "Allow PWM2"
	default y
    select NRFX_PWM2
	help
		Allow the driver to use PWM peripheral instance 2

config RAD_TX_ALLOW_PWM3
	bool "Allow PWM3"
	default y
    select NRFX_PWM3
	help
		Allow the driver to use PWM peripheral instance 3

module = RAD_TX
module-str = RAD_TX
source "${ZEPHYR_BASE}/subsys/logging/Kconfig.template.log_config"

endif #RAD_TX
```

## dts/bindings/rad/dmv,rad-rx.yaml
```yaml
# Copyright (c) 2021 Daniel Veilleux
# SPDX-License-Identifier: LicenseRef-BSD-5-Clause-Nordic

description: Rad laser tag receiver driver

compatible: "dmv,rad-rx"

include: base.yaml

properties:
  label:
    required: true
    type: string
    description: Human readable string describing the device (used as device_get_binding() argument)

  status:
    required: true
    type: string
    description: Human readable string describing the device's status

  gpios:
    type: phandle-array
    description: Sensor OUT pin (input)
    required: true
```

## dts/bindings/rad/dmv,rad-tx.yaml
```yaml
# Copyright (c) 2021 Daniel Veilleux
# SPDX-License-Identifier: LicenseRef-BSD-5-Clause-Nordic

description: Rad laser tag transmitter driver

compatible: "dmv,rad-tx"

include: base.yaml

properties:
  label:
    required: true
    type: string
    description: Human readable string describing the device (used as device_get_binding() argument)

  status:
    required: true
    type: string
    description: Human readable string describing the device's status

  gpios:
    type: phandle-array
    description: LED enable pin
    required: true
```

## lib/rad_msg_type_dynasty/Kconfig
```kconfig
#
# Copyright (c) 2021 Daniel Veilleux
#
# SPDX-License-Identifier: LicenseRef-Nordic-5-Clause
#

menuconfig RAD_MSG_TYPE_DYNASTY
	bool "Rad implementation for working with Laser X messages"

if RAD_MSG_TYPE_DYNASTY

module = RAD_MSG_TYPE_DYNASTY
module-str = RAD_MSG_TYPE_DYNASTY
source "${ZEPHYR_BASE}/subsys/logging/Kconfig.template.log_config"

endif # RAD_MSG_TYPE_DYNASTY
```

## lib/rad_msg_type_laser_x/Kconfig
```kconfig
#
# Copyright (c) 2021 Daniel Veilleux
#
# SPDX-License-Identifier: LicenseRef-Nordic-5-Clause
#

menuconfig RAD_MSG_TYPE_LASER_X
	bool "Rad implementation for working with Laser X messages"

if RAD_MSG_TYPE_LASER_X

module = RAD_MSG_TYPE_LASER_X
module-str = RAD_MSG_TYPE_LASER_X
source "${ZEPHYR_BASE}/subsys/logging/Kconfig.template.log_config"

endif # RAD_MSG_TYPE_LASER_X
```

## lib/rad_msg_type_rad/Kconfig
```kconfig
#
# Copyright (c) 2021 Daniel Veilleux
#
# SPDX-License-Identifier: LicenseRef-Nordic-5-Clause
#

menuconfig RAD_MSG_TYPE_RAD
	bool "Rad implementation for working with Rad messages"

if RAD_MSG_TYPE_RAD

module = RAD_MSG_TYPE_RAD
module-str = RAD_MSG_TYPE_RAD
source "${ZEPHYR_BASE}/subsys/logging/Kconfig.template.log_config"

endif # RAD_MSG_TYPE_RAD
```

## tests/drivers/rad/testcase.yaml
```yaml
common:
  tags: rad
  platform_allow: nrf52840dk_nrf52840
tests:
  drivers.rad.loopback:
    slow: true
    timeout: 400
    tags: drivers rad
    harness_config:
      fixture: rad_fixture
```
